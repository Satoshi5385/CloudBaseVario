## SRC/Kconfig.projbuild
```kconfig
menu "CloudBaseVario application"

    config CBV_SENSOR_RETRY_INTERVAL_MS
        int "Sensor re-detection interval (ms)"
        range 100 10000
        default 2000
        help
            Retry an unavailable BMP581 or HXY IMU without
            blocking the sensor task between attempts.

endmenu
```
